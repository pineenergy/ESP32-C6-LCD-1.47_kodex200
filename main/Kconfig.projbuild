## main/Kconfig.projbuild
```kconfig
menu "Example Configuration"
    config LV_MEM_SIZE_KILOBYTES
        int "Size of the memory used by `lv_mem_alloc` in kilobytes (>= 2kB)"
        default 48
            
    config LV_USE_DEMO_WIDGETS
        bool "Show some widget"
        default y
        
    config LV_DEMO_WIDGETS_SLIDESHOW
        bool "Enable slide show"
        depends on LV_USE_DEMO_WIDGETS
        default y

    config LV_USE_DEMO_KEYPAD_AND_ENCODER
        bool "Demonstrate the usage of encoder and keyboard"
        default y

    config LV_USE_DEMO_BENCHMARK
        bool "Benchmark your system"
        default y

    config LV_USE_DEMO_STRESS
        bool "Stress test for LVGL"
        default y

    config LV_USE_DEMO_MUSIC
        bool "Music player demo"
        default y

    
    config LV_FONT_MONTSERRAT_12
        bool "Enable Montserrat 12"
        default y if !LV_CONF_MINIMAL

    config LV_FONT_MONTSERRAT_14
        bool "Enable Montserrat 14"
        default y if !LV_CONF_MINIMAL

    config LV_FONT_MONTSERRAT_16
        bool "Enable Montserrat 16"
        default y if !LV_CONF_MINIMAL
        


    config BT_ENABLED
        bool "Select this option to enable Bluetooth"
        default y 

    config BT_BLE_50_FEATURES_SUPPORTED
        bool "Enabling this option activates BLE 5.0 features"
        default y 
        
    config BT_BLE_42_FEATURES_SUPPORTED
        bool "This enables BLE 4.2 features."
        default y 

    config APP_WIFI_SSID
        string "Wi-Fi SSID for internet access"
        default ""

    config APP_WIFI_PASSWORD
        string "Wi-Fi password"
        default ""

    config APP_WIFI_SSID_2
        string "Secondary Wi-Fi SSID"
        default ""

    config APP_WIFI_PASSWORD_2
        string "Secondary Wi-Fi password"
        default ""

    config APP_STOCK_SYMBOL_KODEX200
        string "Yahoo symbol for KODEX200"
        default "069500.KS"

    config APP_STOCK_SYMBOL_SMR
        string "Yahoo symbol for KODEX Wonjaryeok SMR"
        default "471460.KS"

    config APP_STOCK_UPDATE_PERIOD_SEC
        int "Stock update period (seconds)"
        range 10 3600
        default 60
endmenu
```

## sdkconfig.defaults
```kconfig
CONFIG_SPIRAM=y
CONFIG_SPIRAM_MODE_OCT=y
CONFIG_SPIRAM_SPEED_80M=y

CONFIG_LV_USE_USER_DATA=y
CONFIG_LV_USE_CHART=y
CONFIG_LV_USE_PERF_MONITOR=y

CONFIG_ESPTOOLPY_FLASHSIZE_4MB=y
CONFIG_PARTITION_TABLE_CUSTOM=y
CONFIG_APP_WIFI_SSID="LEE_2.4GHz"
CONFIG_APP_WIFI_PASSWORD="LEEpassword"
CONFIG_APP_WIFI_SSID_2="instk"
CONFIG_APP_WIFI_PASSWORD_2="instkPassword"
CONFIG_APP_STOCK_SYMBOL_KODEX200="069500.KS"
CONFIG_APP_STOCK_SYMBOL_SMR="0098F0"
CONFIG_APP_STOCK_UPDATE_PERIOD_SEC=15
```
